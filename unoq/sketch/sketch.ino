// SPDX-FileCopyrightText: Copyright (C) Arduino s.r.l. and/or its affiliated companies
//
// SPDX-License-Identifier: MPL-2.0
//
// Recall — Arduino UNO Q, MCU (real-time) side.
// Implements the "MCU Side" of Architecture doc section 2:
//   * LED state machine (capturing / searching / recalled / muted / error)
//   * MCU watchdog: error blink if the Linux side goes silent
// (Push-button bookmark/forget and the hardware mute switch are intentionally
//  not implemented; the "muted" LED state is still driven by the hub.)
//
// The LED matrix is monochrome (8 rows x 12 columns), so the spec's colours are
// mapped to distinct patterns: amber(capturing)=solid block, blue(searching)=
// checker, green(recalled)=tick, red(muted)=X, red(error)=full blink.
// The original "Hey Recall" heart flourish (keyword_detected -> wake_up) is
// preserved — now driven non-blockingly so it never stalls the RPC bridge.
//
// RPC contract with unoq/main.py (names + LED indices MUST match that file):
//   provide  keyword_detected()        -> heart flourish
//   provide  set_led_state(int 0..5)   -> LED_STATES index
//   provide  mcu_ping()                -> Linux-alive heartbeat
//
// heart_frames.h (generated by App Lab, not in the repo) must export:
//   const uint32_t HeartStatic[...];   // static heart frame for loadFrame()
//   const uint32_t HeartAnim[...];     // sequence for loadSequence()/playSequence()

#include <Arduino.h>
#include <Arduino_LED_Matrix.h>
#include <Arduino_RouterBridge.h>

#include "heart_frames.h"

Arduino_LED_Matrix matrix;

// ---- LED states (MUST stay in sync with LED_STATES in unoq/main.py) --------
enum LedState {
  LED_IDLE      = 0,   // heart
  LED_CAPTURING = 1,   // amber -> solid block
  LED_SEARCHING = 2,   // blue  -> checkerboard
  LED_RECALLED  = 3,   // green -> tick
  LED_MUTED     = 4,   // red   -> X
  LED_ERROR     = 5,   // red   -> full blink
};

// ---- Config ---------------------------------------------------------------
const unsigned long ANIM_MS           = 1000;   // heart flourish duration
const unsigned long BRIDGE_TIMEOUT_MS = 8000;   // Linux silent -> watchdog
const unsigned long STARTUP_GRACE_MS  = 30000;  // boot window before watchdog can fire
const unsigned long BLINK_MS          = 400;    // watchdog blink half-period
const unsigned long LOOP_MS           = 10;     // main-loop tick

// ---- Shared state (written in RPC callbacks, read in loop) -----------------
// Marked volatile; loop() snapshots them under a brief critical section so a
// callback can't interleave between the read and the gDirty clear.
volatile int           gLedState     = LED_IDLE;
volatile bool          gDirty        = true;    // LED needs a re-render
volatile bool          gAnimating    = false;   // heart flourish in progress
volatile unsigned long gAnimEnd      = 0;       // millis() when the flourish ends
volatile unsigned long gLastBridgeMs = 0;       // last time the Linux side spoke
volatile bool          gEverHeard    = false;

// ---- Watchdog blink state (loop-only; no cross-thread access) --------------
bool          gInWatchdog = false;
unsigned long gBlinkAt    = 0;
bool          gBlinkOn    = false;

// ---------------------------------------------------------------------------
// Frame helpers
// ---------------------------------------------------------------------------
// Pack an 8-row x 12-col (row-major) on/off grid into the 3x uint32 the matrix
// expects (pixel 0,0 = MSB of word 0).
void packFrame(const uint8_t px[8][12], uint32_t out[3]) {
  out[0] = out[1] = out[2] = 0;
  for (int r = 0; r < 8; r++) {
    for (int c = 0; c < 12; c++) {
      int idx = r * 12 + c;                 // 0..95
      if (px[r][c]) out[idx / 32] |= (uint32_t)1 << (31 - (idx % 32));
    }
  }
}

void renderState(int s) {
  if (s == LED_IDLE) {           // keep the heart as the resting face
    matrix.loadFrame(HeartStatic);
    return;
  }

  uint8_t px[8][12];
  memset(px, 0, sizeof(px));

  switch (s) {
    case LED_CAPTURING:                              // solid block ("recording")
      for (int r = 2; r < 6; r++)
        for (int c = 4; c < 8; c++) px[r][c] = 1;
      break;
    case LED_SEARCHING:                              // checkerboard ("scanning")
      for (int r = 0; r < 8; r++)
        for (int c = 0; c < 12; c++) px[r][c] = (r + c) & 1;
      break;
    case LED_RECALLED: {                             // checkmark ("recalled")
      // Short stroke down-right, long stroke up-right — a proper tick.
      const int pts[8][2] = {{6,1},{7,2},{6,3},{5,4},{4,5},{3,6},{2,7},{1,8}};
      for (int i = 0; i < 8; i++) px[pts[i][0]][pts[i][1]] = 1;
      break;
    }
    case LED_MUTED:                                  // X ("muted / privacy")
      for (int i = 0; i < 8; i++) { px[i][i + 2] = 1; px[i][9 - i] = 1; }
      break;
    case LED_ERROR:                                  // full grid ("error")
    default:                                         // unknown state -> error grid
      for (int r = 0; r < 8; r++)
        for (int c = 0; c < 12; c++) px[r][c] = 1;
      break;
  }

  uint32_t frame[3];
  packFrame(px, frame);
  matrix.loadFrame(frame);
}

// ---------------------------------------------------------------------------
// RPC callbacks (called by the Linux/Python side over the bridge)
// All are registered with provide_safe -> served cooperatively in the loop
// hook, so they must NOT block (no delay()).
// ---------------------------------------------------------------------------
void wake_up() {                        // "Hey Recall" heart flourish (non-blocking)
  gLastBridgeMs = millis();
  gEverHeard = true;
  gAnimating = true;
  gAnimEnd = millis() + ANIM_MS;        // loop() reverts to the state machine at this time
  matrix.loadSequence(HeartAnim);
  matrix.playSequence();                // plays on the matrix's own timer — returns immediately
}

void set_led_state(int state) {         // hub-driven LED state machine
  gLastBridgeMs = millis();
  gEverHeard = true;
  if (state < LED_IDLE || state > LED_ERROR) state = LED_ERROR;   // clamp garbage
  gLedState = state;
  gDirty = true;
}

void mcu_ping() {                       // heartbeat: Linux side is alive
  gLastBridgeMs = millis();
  gEverHeard = true;
}

// ---------------------------------------------------------------------------
// Setup / loop
// ---------------------------------------------------------------------------
void setup() {
  matrix.begin();
  matrix.clear();
  matrix.loadFrame(HeartStatic);

  Bridge.begin();
  // All provide_safe: served in the loop hook, never in an ISR/serial context,
  // so callbacks can touch the matrix and must stay non-blocking.
  Bridge.provide_safe("keyword_detected", wake_up);
  Bridge.provide_safe("set_led_state", set_led_state);
  Bridge.provide_safe("mcu_ping", mcu_ping);

  gLastBridgeMs = millis();
}

void loop() {
  unsigned long now = millis();

  // ---- End the heart flourish once its time is up (wrap-safe) ----
  if (gAnimating && (long)(now - gAnimEnd) >= 0) {
    gAnimating = false;
    gDirty = true;                      // repaint the real state (idle=heart, or capturing)
  }

  // ---- MCU watchdog: blink error if the Linux side went silent ----
  // Fires after BRIDGE_TIMEOUT_MS of silence once we've heard from Linux, OR
  // after STARTUP_GRACE_MS if we never heard from it at all (Linux never booted).
  bool linuxSilent =
      (gEverHeard && (now - gLastBridgeMs > BRIDGE_TIMEOUT_MS)) ||
      (!gEverHeard && now > STARTUP_GRACE_MS);
  if (linuxSilent) {
    if (!gInWatchdog) {                 // fresh entry: reset blink state (no stale statics)
      gInWatchdog = true;
      gBlinkAt = now;
      gBlinkOn = false;
    }
    if (now - gBlinkAt >= BLINK_MS) {
      gBlinkAt = now;
      gBlinkOn = !gBlinkOn;
      if (gBlinkOn) renderState(LED_ERROR);
      else matrix.clear();
    }
    delay(LOOP_MS);
    return;                             // hold error until Linux returns
  } else if (gInWatchdog) {             // just recovered -> repaint the real state
    gInWatchdog = false;
    gDirty = true;
  }

  // ---- Render current LED state on change (snapshot to avoid a r-m-w race) ----
  noInterrupts();
  bool anim  = gAnimating;
  bool dirty = gDirty;
  int  state = gLedState;
  if (dirty && !anim) gDirty = false;   // clear only when we will actually render
  interrupts();
  if (dirty && !anim) renderState(state);

  delay(LOOP_MS);
}
